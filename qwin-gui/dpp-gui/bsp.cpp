//============================================================================
// Product: DPP example, Win32-GUI
//
// Copyright (C) 2005 Quantum Leaps, LLC. All rights reserved.
//
//                    Q u a n t u m  L e a P s
//                    ------------------------
//                    Modern Embedded Software
//
// SPDX-License-Identifier: GPL-3.0-or-later OR LicenseRef-QL-commercial
//
// This software is dual-licensed under the terms of the open-source GNU
// General Public License (GPL) or under the terms of one of the closed-
// source Quantum Leaps commercial licenses.
//
// Redistributions in source code must retain this top-level comment block.
// Plagiarizing this software to sidestep the license obligations is illegal.
//
// NOTE:
// The GPL does NOT permit the incorporation of this code into proprietary
// programs. Please contact Quantum Leaps for commercial licensing options,
// which expressly supersede the GPL and are designed explicitly for
// closed-source distribution.
//
// Quantum Leaps contact information:
// <www.state-machine.com/licensing>
// <info@state-machine.com>
//============================================================================
#include "qpcpp.hpp"   // QP/C++ real-time event framework
#include "bsp.hpp"     // Board Support Package
#include "app.hpp"     // Application

#include "qwin_gui.h"  // QWIN GUI
#include "resource.h"  // GUI resource IDs generated by the resource editor

#include "safe_std.h"  // portable "safe" <stdio.h>/<string.h> facilities

//============================================================================
namespace { // unnamed local namespace

Q_DEFINE_THIS_FILE

// local variables -----------------------------------------------------------
static HINSTANCE l_hInst;   // this application instance
static HWND      l_hWnd;    // main window handle
static LPSTR     l_cmdLine; // the command line string

static SegmentDisplay   l_philos;   // SegmentDisplay to show Philo status
static OwnerDrawnButton l_pauseBtn; // owner-drawn button

static unsigned l_rnd;  // random seed

#ifdef Q_SPY
    enum {
        PHILO_STAT = QP::QS_USER,
        PAUSED_STAT,
        COMMAND_STAT
    };
    static std::uint8_t const l_clock_tick = 0U;
#endif

} // unnamed namespace

//============================================================================
// Error handler

extern "C" {

Q_NORETURN Q_onError(char const * const module, int_t const id) {
    Q_UNUSED_PAR(module);
    Q_UNUSED_PAR(id);

    QP::QF::stop(); // stop ticking

    QS_ASSERTION(module, id, 10000U); // report assertion to QS

    char message[80];
    SNPRINTF_S(message, Q_DIM(message) - 1U,
        "Assertion failed in module %s:%d", module, id);
    MessageBox(l_hWnd, message, "!!! ASSERTION !!!",
        MB_OK | MB_ICONEXCLAMATION | MB_APPLMODAL);
    PostQuitMessage(-1);
}

// Local functions -----------------------------------------------------------
static LRESULT CALLBACK WndProc(HWND hWnd, UINT iMsg,
    WPARAM wParam, LPARAM lParam);

} // extern "C"

//============================================================================
namespace BSP {

//............................................................................
void init(void const * const arg) {
    Q_UNUSED_PAR(arg);

    if (!QS_INIT(l_cmdLine)) { // QS initialization failed?
        MessageBox(l_hWnd,
            "Cannot connect to QSPY via TCP/IP\n"
            "Please make sure that 'qspy -t' is running",
            "QS_INIT() Error",
            MB_OK | MB_ICONEXCLAMATION | MB_APPLMODAL);
    }

    // send the QS dictionaries...
    QS_OBJ_DICTIONARY(&l_clock_tick);
    QS_USR_DICTIONARY(PHILO_STAT);
    QS_USR_DICTIONARY(PAUSED_STAT);
    QS_ONLY(APP::produce_sig_dict());

    // setup the QS filters...
    QS_GLB_FILTER(QP::QS_GRP_ALL);  // enable all QS trace records
    QS_GLB_FILTER(-QP::QS_QF_TICK); // exclude the tick record

    // initialize event pools
    static QF_MPOOL_EL(APP::TableEvt) smlPoolSto[2*APP::N_PHILO];
    QP::QF::poolInit(smlPoolSto,
                     sizeof(smlPoolSto), sizeof(smlPoolSto[0]));

    // initialize publish-subscribe
    static QP::QSubscrList subscrSto[APP::MAX_PUB_SIG];
    QP::QActive::psInit(subscrSto, Q_DIM(subscrSto));

    // start AOs...
    static QP::QEvtPtr philoQueueSto[APP::N_PHILO][10];
    for (std::uint8_t n = 0U; n < APP::N_PHILO; ++n) {
        APP::AO_Philo[n]->start(n + 1U,
            philoQueueSto[n], Q_DIM(philoQueueSto[n]),
            nullptr, 0U);
    }

    static QP::QEvtPtr tableQueueSto[APP::N_PHILO];
    APP::AO_Table->start(APP::N_PHILO + 7U,
        tableQueueSto, Q_DIM(tableQueueSto),
        nullptr, 0U);
}
//............................................................................
void terminate(std::int16_t result) {
    QP::QF::stop(); // stop the main QF application

    // cleanup all QWIN resources...
    OwnerDrawnButton_xtor(&l_pauseBtn); // cleanup the l_pauseBtn resources
    SegmentDisplay_xtor(&l_philos);     // cleanup the l_philos resources

    // end the main dialog
    EndDialog(l_hWnd, result);
}
//............................................................................
void displayPhilStat(std::uint8_t n, char const *stat) {
    UINT bitmapNum = 0;

    Q_REQUIRE(n < APP::N_PHILO);

    switch (stat[0]) {
        case 't': bitmapNum = 0U; break;
        case 'h': bitmapNum = 1U; break;
        case 'e': bitmapNum = 2U; break;
        default: Q_ERROR();  break;
    }
    // set the "segment" # n to the bitmap # 'bitmapNum'
    SegmentDisplay_setSegment(&l_philos, (UINT)n, bitmapNum);

    // application-specific trace record
    QS_BEGIN_ID(PHILO_STAT, APP::AO_Table->getPrio())
        QS_U8(1, n);  // Philosopher number
        QS_STR(stat); // Philosopher status
    QS_END()
}
//............................................................................
void displayPaused(std::uint8_t paused) {
    char buf[16];
    LoadString(l_hInst,
        (paused != 0U) ? IDS_PAUSED : IDS_RUNNING, buf, Q_DIM(buf));
    SetDlgItemText(l_hWnd, IDC_PAUSED, buf);

    // application-specific trace record
    QS_BEGIN_ID(PAUSED_STAT, APP::AO_Table->getPrio())
        QS_U8(1, paused);  // Paused status
    QS_END()
}
//............................................................................
void randomSeed(std::uint32_t const seed) {
    l_rnd = seed;
}
//............................................................................
std::uint32_t random() { // a very cheap pseudo-random-number generator

    // "Super-Duper" Linear Congruential Generator (LCG)
    // LCG(2^32, 3*7*11*13*23, 0, seed)
    l_rnd = l_rnd * (3U*7U*11U*13U*23U);
    return l_rnd >> 8U;
}


} // unnamed local namespace

//============================================================================
namespace QP {

//............................................................................
void QF::onStartup(void) {
    QF::setTickRate(BSP::TICKS_PER_SEC, 30); // set the desired tick rate
}
//............................................................................
void QF::onCleanup(void) {
}
//............................................................................
void QF::onClockTick(void) {
    // perform the QF clock tick processing
    QTimeEvt::TICK_X(0U, &l_clock_tick);

    QS_RX_INPUT(); // handle the QS-RX input
    QS_OUTPUT();   // handle the QS output
}

} // namespace QP

//============================================================================
extern "C" {

//============================================================================
// thread function for running the application main_gui()
static DWORD WINAPI appThread(LPVOID par) {
    Q_UNUSED_PAR(par);
    return main_gui(); // run the QF application
}

//............................................................................
int WINAPI WinMain(HINSTANCE hInst, HINSTANCE hPrevInst,
    LPSTR cmdLine, int iCmdShow)
{
    Q_UNUSED_PAR(hPrevInst);

    l_hInst   = hInst;   // save the application instance
    l_cmdLine = cmdLine; // save the command line string

    //AllocConsole();

    // create the main custom dialog window
    HWND hWnd = CreateCustDialog(hInst, IDD_APPLICATION, NULL,
        &WndProc, "MY_CLASS");
    ShowWindow(hWnd, iCmdShow); // show the main window

    // enter the message loop...
    MSG msg;
    while (GetMessage(&msg, NULL, 0, 0)) {
        TranslateMessage(&msg);
        DispatchMessage(&msg);
    }

    //FreeConsole();
    BSP::terminate(0);

    return msg.wParam;
}

//............................................................................
static LRESULT CALLBACK WndProc(HWND hWnd, UINT iMsg,
    WPARAM wParam, LPARAM lParam)
{
    switch (iMsg) {

        // Perform initialization upon creation of the main dialog window
        // NOTE: Any child-windows are NOT created yet at this time, so
        // the GetDlgItem() function can't be used (it will return NULL).
        //
        case WM_CREATE: {
            l_hWnd = hWnd; // save the window handle

            // initialize the owner-drawn buttons...
            // NOTE: must be done *before* the first drawing of the buttons,
            // so WM_INITDIALOG is too late.
            //
            OwnerDrawnButton_init(&l_pauseBtn, IDC_PAUSE,
                LoadBitmap(l_hInst, MAKEINTRESOURCE(IDB_BTN_UP)),
                LoadBitmap(l_hInst, MAKEINTRESOURCE(IDB_BTN_DWN)),
                LoadCursor(NULL, IDC_HAND));
            return 0;
        }

        // Perform initialization after all child windows have been created
        case WM_INITDIALOG: {

            SegmentDisplay_init(&l_philos,
                     APP::N_PHILO,  // N_PHILO "segments" for the Philos
                     3U);           // 3 bitmaps (for thinking/hungry/eating)
            SegmentDisplay_initSegment(&l_philos, 0U, IDC_PHILO_0);
            SegmentDisplay_initSegment(&l_philos, 1U, IDC_PHILO_1);
            SegmentDisplay_initSegment(&l_philos, 2U, IDC_PHILO_2);
            SegmentDisplay_initSegment(&l_philos, 3U, IDC_PHILO_3);
            SegmentDisplay_initSegment(&l_philos, 4U, IDC_PHILO_4);
            SegmentDisplay_initBitmap(&l_philos,
                 0U, LoadBitmap(l_hInst, MAKEINTRESOURCE(IDB_THINKING)));
            SegmentDisplay_initBitmap(&l_philos,
                 1U, LoadBitmap(l_hInst, MAKEINTRESOURCE(IDB_HUNGRY)));
            SegmentDisplay_initBitmap(&l_philos,
                 2U, LoadBitmap(l_hInst, MAKEINTRESOURCE(IDB_EATING)));

            // --> QP: spawn the application thread to run main()
            HANDLE hThr = CreateThread(NULL, 0, &appThread, NULL, 0, NULL);
            Q_ASSERT(hThr != (HANDLE)0);

            SetDlgItemTextA(hWnd, IDC_EDIT1, "Edit1");
            SetDlgItemTextA(hWnd, IDC_EDIT2, "Edit2");
            return 0;
        }

        case WM_DESTROY: {
            PostQuitMessage(0);
            return 0;
        }

        // commands from child controls and menus...
        case WM_COMMAND: {
            switch (wParam) {
                case IDOK:
                case IDCANCEL: {
                    PostQuitMessage(0);
                    break;
                }
                case IDC_PAUSE: { // owner-drawn button(s)
                    SetFocus(hWnd);
                    break;
                }
                case IDC_BUTTON1: { // regular button
                    char buf[32];
                    GetDlgItemTextA(hWnd, IDC_EDIT1, buf, sizeof(buf));
                    SetDlgItemTextA(hWnd, IDC_EDIT2, buf);
                    break;
                }
            }
            return 0;
        }

        // drawing of owner-drawn buttons...
        case WM_DRAWITEM: {
            LPDRAWITEMSTRUCT pdis = (LPDRAWITEMSTRUCT)lParam;
            switch (pdis->CtlID) {
                case IDC_PAUSE: { // PAUSE owner-drawn button
                    switch (OwnerDrawnButton_draw(&l_pauseBtn,pdis)) {
                        case BTN_DEPRESSED: {
                            static QP::QEvt const pe(APP::PAUSE_SIG);
                            APP::AO_Table->POST(&pe, nullptr);
                            break;
                        }
                        case BTN_RELEASED: {
                            static QP::QEvt const se(APP::SERVE_SIG);
                            APP::AO_Table->POST(&se, nullptr);
                            break;
                        }
                        default: {
                            break;
                        }
                    }
                    break;
                }
            }
            return 0;
        }

        // mouse input...
        case WM_MOUSEWHEEL: {
            return 0;
        }

        // keyboard input...
        case WM_KEYDOWN: {
            return 0;
        }
    }
    return DefWindowProc(hWnd, iMsg, wParam, lParam) ;
}

} // extern "C"

//============================================================================
namespace QP {

#ifdef Q_SPY // define QS callbacks

//............................................................................
void QS::onCommand(std::uint8_t cmdId,
    std::uint32_t param1, std::uint32_t param2, std::uint32_t param3)
{
    Q_UNUSED_PAR(cmdId);
    Q_UNUSED_PAR(param1);
    Q_UNUSED_PAR(param2);
    Q_UNUSED_PAR(param3);
}

#endif // Q_SPY

} // namespace QP
