## CMakeLists.txt
```
# QPCPP Zephyr example
# SPDX-License-Identifier: GPL-3.0-or-later OR LicenseRef-QL-commercial

cmake_minimum_required(VERSION 3.20.0)
find_package(Zephyr REQUIRED HINTS $ENV{ZEPHYR_BASE})

project(real-time)

target_sources(app PRIVATE
 src/main.cpp
 src/bsp.cpp
 src/periodic1.cpp
 src/periodic4.cpp
 src/sporadic2.cpp
 src/sporadic3.cpp
)

# QPCPP framework directory
# NOTE:
# Adjust this path for a different relative path
# between your project and the QPCPP folder
#
set(QPCPP_DIR ../../..)

# option to turn QSPY software tracing ON or OFF (file prj.conf)
# NOTE:
# change of the option might require re-building the project
#
option(QSPY "QSPY software tracing" OFF)

# QPCPP framework includes and sources...
zephyr_include_directories(
 ${QPCPP_DIR}/include
 ${QPCPP_DIR}/zephyr
 ./src
)
target_sources(app PRIVATE
 ${QPCPP_DIR}/src/qf/qep_hsm.cpp
 ${QPCPP_DIR}/src/qf/qep_msm.cpp
 ${QPCPP_DIR}/src/qf/qf_act.cpp
 ${QPCPP_DIR}/src/qf/qf_qact.cpp
 ${QPCPP_DIR}/src/qf/qf_defer.cpp
 ${QPCPP_DIR}/src/qf/qf_dyn.cpp
 ${QPCPP_DIR}/src/qf/qf_mem.cpp
 ${QPCPP_DIR}/src/qf/qf_ps.cpp
 ${QPCPP_DIR}/src/qf/qf_qact.cpp
 ${QPCPP_DIR}/src/qf/qf_qeq.cpp
 ${QPCPP_DIR}/src/qf/qf_qmact.cpp
 ${QPCPP_DIR}/src/qf/qf_time.cpp
 ${QPCPP_DIR}/zephyr/qf_port.cpp
)

# application-level "idle thread"...
if(QIDLE)
add_compile_definitions(QF_IDLE)
endif()
```

## prj.conf
```kconfig
# QPCPP Zephyr application
# SPDX-License-Identifier: GPL-3.0-or-later OR LicenseRef-QL-commercial
CONFIG_CPP=y
CONFIG_GLIBCXX_LIBCPP=y

CONFIG_SYS_CLOCK_TICKS_PER_SEC=5000

CONFIG_THREAD_NAME=y
CONFIG_REBOOT=y
CONFIG_GPIO=y

# reduce the Zephyr RAM footprint, see:
# https://docs.zephyrproject.org/latest/develop/optimizations/footprint.html
CONFIG_ISR_STACK_SIZE=1024
CONFIG_MAIN_STACK_SIZE=512
CONFIG_SYSTEM_WORKQUEUE_STACK_SIZE=512
CONFIG_PRIVILEGED_STACK_SIZE=512
```

## src/main.cpp
```c
//============================================================================
// APP example
//
// Copyright (C) 2005-2026 Quantum Leaps, LLC. All rights reserved.
//
//                    Q u a n t u m  L e a P s
//                    ------------------------
//                    Modern Embedded Software
//
// SPDX-License-Identifier: GPL-3.0-or-later OR LicenseRef-QL-commercial
//
// This software is dual-licensed under the terms of the open-source GNU
// General Public License, version 3 or later (GPL-3.0-or-later), or,
// alternatively, under the terms of one of the closed-source Quantum Leaps
// commercial licenses.
//
// Redistributions in source code must retain this top-level comment block.
//
// NOTE:
// The GPL does NOT permit distributing this code as part of proprietary
// (closed-source) programs. For such use, please contact Quantum Leaps for
// a commercial license, which is an alternative to the GPL designed
// explicitly for closed-source distribution.
//
// Quantum Leaps contact information:
// <www.state-machine.com/licensing>
// <info@state-machine.com>
//============================================================================
#include "qpcpp.hpp"      // QP/C++ real-time event framework
#include "bsp.hpp"        // Board Support Package
#include "app.hpp"        // Application interface

//............................................................................
int main() {
    QP::QF::init();       // initialize the framework and the underlying RT kernel
    BSP::init(nullptr);   // initialize the BSP and start the AOs
    return QP::QF::run(); // run the QF application
}
```

## src/bsp.cpp
```c
//============================================================================
// BSP for "real-time" Example, NUCLEO-C031C6 board, Zephyr RTOS
//
// Copyright (C) 2005-2026 Quantum Leaps, LLC. All rights reserved.
//
//                    Q u a n t u m  L e a P s
//                    ------------------------
//                    Modern Embedded Software
//
// SPDX-License-Identifier: GPL-3.0-or-later OR LicenseRef-QL-commercial
//
// This software is dual-licensed under the terms of the open-source GNU
// General Public License, version 3 or later (GPL-3.0-or-later), or,
// alternatively, under the terms of one of the closed-source Quantum Leaps
// commercial licenses.
//
// Redistributions in source code must retain this top-level comment block.
//
// NOTE:
// The GPL does NOT permit distributing this code as part of proprietary
// (closed-source) programs. For such use, please contact Quantum Leaps for
// a commercial license, which is an alternative to the GPL designed
// explicitly for closed-source distribution.
//
// Quantum Leaps contact information:
// <www.state-machine.com/licensing>
// <info@state-machine.com>
//============================================================================
#include "qpcpp.hpp"           // QP/C++ real-time event framework
#include "bsp.hpp"             // Board Support Package
#include "app.hpp"             // Application interface

#include <zephyr/drivers/gpio.h>
#include <zephyr/sys/reboot.h>
// add other drivers if necessary...

#ifdef Q_SPY
    #error QP/Spy software tracing not available in this application
#endif

// Local-scope objects -----------------------------------------------------
namespace { // anonymous local namespace

Q_DEFINE_THIS_FILE // define the name of this file for assertions

// test pins on GPIO PA (output)
constexpr std::uint32_t TST1_PIN  {7U};
constexpr std::uint32_t TST2_PIN  {6U};
constexpr std::uint32_t TST3_PIN  {4U};
constexpr std::uint32_t TST4_PIN  {1U};
constexpr std::uint32_t TST5_PIN  {0U};
constexpr std::uint32_t TST6_PIN  {9U};
constexpr std::uint32_t TST7_PIN  {5U}; // LED LD2-Green

// Button pins available on the board (just one user Button B1 on PC.13)
// button on GPIO PC (input)
constexpr std::uint32_t B1_PIN    {13U};

static struct k_timer zephyr_tick_timer;

} // anonymous local namespace

//============================================================================
// Error handler

extern "C" {

Q_NORETURN Q_onError(char const * const module, int_t const id) {
    // NOTE: this implementation of the error handler is intended only
    // for debugging and MUST be changed for deployment of the application
    // (assuming that you ship your production code with assertions enabled).
    Q_UNUSED_PAR(module);
    Q_UNUSED_PAR(id);
    QS_ASSERTION(module, id, 10000U); // report assertion to QS

#ifndef NDEBUG
    Q_PRINTK("\nERROR in %s:%d\n", module, id);
    k_panic(); // debug build: halt the system for error search...
#endif
    sys_reboot(SYS_REBOOT_COLD); // release build: reboot the system
    for (;;) { // explicitly "no-return"
    }
}
//............................................................................
// assertion failure handler for the STM32 library, including the startup code
void assert_failed(char const * const module, int_t const id); // prototype
void assert_failed(char const * const module, int_t const id) {
    Q_onError(module, id);
}

//............................................................................
static void custom_tick_callback(struct k_timer *tid); // prototype
static void custom_tick_callback(struct k_timer *tid) {
    Q_UNUSED_PAR(tid);

    BSP::d1on();

    QP::QTimeEvt::TICK_X(0U, nullptr); // time events at rate 0

    // Perform the debouncing of buttons. The algorithm for debouncing
    // adapted from the book "Embedded Systems Dictionary" by Jack Ganssle
    // and Michael Barr, page 71.
    static struct {
        std::uint32_t depressed;
        std::uint32_t previous;
    } buttons = { 0U, 0U };

    std::uint32_t current = ~GPIOC->IDR; // read Port C with state of Button B1
    std::uint32_t tmp = buttons.depressed; // save the depressed buttons
    buttons.depressed |= (buttons.previous & current); // set depressed
    buttons.depressed &= (buttons.previous | current); // clear released
    buttons.previous   = current; // update the history
    tmp ^= buttons.depressed;     // changed debounced depressed
    current = buttons.depressed;

    if ((tmp & (1U << B1_PIN)) != 0U) { // debounced B1 state changed?
        if ((current & (1U << B1_PIN)) != 0U) { // is B1 depressed?
            // immutable sporadic-press event
            static APP::SporadicSpecEvt const
                sporadicA(APP::SPORADIC_A_SIG, 189U, 0U);
            // immutable forward-press event
            static APP::SporadicSpecEvt const
                sporadicB(APP::SPORADIC_B_SIG, 89U, 0U);
            APP::AO_Sporadic2->POST(&sporadicA, nullptr);
            APP::AO_Sporadic2->POST(&sporadicB, nullptr);
        }
        else { // B1 is released
            APP::AO_Periodic4->POST(BSP::getEvtPeriodic4(0U), nullptr);
            APP::AO_Periodic1->POST(BSP::getEvtPeriodic1(0U), nullptr);
        }
    }

    BSP::d1off();
}

} // extern "C"

// BSP functions =============================================================
namespace BSP {

void init(void const * const arg) {
    Q_UNUSED_PAR(arg);

    // NOTE: the CPU clock is configured in Zephyr (48MHz)

    // Configure the MPU to prevent NULL-pointer dereferencing ...
    MPU->RBAR = 0x0U                          // base address (NULL)
                | MPU_RBAR_VALID_Msk          // valid region
                | (MPU_RBAR_REGION_Msk & 7U); // region #7
    MPU->RASR = (7U << MPU_RASR_SIZE_Pos)     // 2^(7+1) region
                | (0x0U << MPU_RASR_AP_Pos)   // no-access region
                | MPU_RASR_ENABLE_Msk;        // region enable
    MPU->CTRL = MPU_CTRL_PRIVDEFENA_Msk       // enable background region
                | MPU_CTRL_ENABLE_Msk;        // enable the MPU
    __ISB();
    __DSB();

    // enable GPIO port PA clock
    RCC->IOPENR |= (1U << 0U);

    // set all used GPIOA pins as push-pull output, no pull-up, pull-down
    GPIOA->MODER &=
        ~((3U << 2U*TST1_PIN) | (3U << 2U*TST2_PIN) | (3U << 2U*TST3_PIN) |
          (3U << 2U*TST4_PIN) | (3U << 2U*TST5_PIN) | (3U << 2U*TST6_PIN) |
          (3U << 2U*TST7_PIN));
    GPIOA->MODER |=
         ((1U << 2U*TST1_PIN) | (1U << 2U*TST2_PIN) | (1U << 2U*TST3_PIN) |
          (1U << 2U*TST4_PIN) | (1U << 2U*TST5_PIN) | (1U << 2U*TST6_PIN) |
          (1U << 2U*TST7_PIN));
    GPIOA->OTYPER &=
        ~((1U <<    TST1_PIN) | (1U <<    TST2_PIN) | (1U <<    TST3_PIN) |
          (1U <<    TST4_PIN) | (1U <<    TST5_PIN) | (1U <<    TST6_PIN) |
          (1U <<    TST7_PIN));
    GPIOA->PUPDR &=
        ~((3U << 2U*TST1_PIN) | (3U << 2U*TST2_PIN) | (3U << 2U*TST3_PIN) |
          (3U << 2U*TST4_PIN) | (3U << 2U*TST5_PIN) | (3U << 2U*TST6_PIN) |
          (3U << 2U*TST7_PIN));

    // enable GPIOC clock port for the Button B1
    RCC->IOPENR |=  (1U << 2U);

    // configure Button B1 pin on GPIOC as input, no pull-up, pull-down
    GPIOC->MODER &= ~(3U << 2U*B1_PIN);
    GPIOC->PUPDR &= ~(3U << 2U*B1_PIN);

    // instantiate and start QP/C++ active objects...
    static QP::QEvtPtr periodic1QSto[10]; // Event queue storage
    static K_THREAD_STACK_DEFINE(periodic1Stack, 512);
    APP::AO_Periodic1->start(
        QP::QF::prioSpec(1U, 4U), // QF-prio/Zephyr-prio
        periodic1QSto,         // storage for the AO's queue
        Q_DIM(periodic1QSto),  // queue length
        periodic1Stack,        // stack storage (needed for FreeRTOS)
        K_THREAD_STACK_SIZEOF(periodic1Stack), // stack size [Zephyr]
        getEvtPeriodic1(0U));  // initialization param

    static QP::QEvtPtr sporadic2QSto[8]; // Event queue storage
    static K_THREAD_STACK_DEFINE(sporadic2Stack, 512);
    APP::AO_Sporadic2->start(
        QP::QF::prioSpec(2U, 3U), // QF-prio/Zephyr-prio
        sporadic2QSto,         // storage for the AO's queue
        Q_DIM(sporadic2QSto),  // queue length
        sporadic2Stack,        // stack storage (needed for FreeRTOS)
        K_THREAD_STACK_SIZEOF(sporadic2Stack), // stack size [Zephyr]
        (void const *)0);      // initialization param -- not used

    static QP::QEvtPtr sporadic3QSto[8]; // Event queue storage
    static K_THREAD_STACK_DEFINE(sporadic3Stack, 512);
    APP::AO_Sporadic3->start(
        QP::QF::prioSpec(3U, 2U), // QF-prio/Zephyr-prio
        sporadic3QSto,         // storage for the AO's queue
        Q_DIM(sporadic3QSto),  // queue length
        sporadic3Stack,        // stack storage (needed for FreeRTOS)
        K_THREAD_STACK_SIZEOF(sporadic3Stack), // stack size [Zephyr]
        (void const *)0);      // initialization param -- not used

    static QP::QEvtPtr periodic4QSto[8]; // Event queue storage
    static K_THREAD_STACK_DEFINE(periodic4Stack, 512);
    APP::AO_Periodic4->start(
        QP::QF::prioSpec(4U, 1U), // QF-prio/Zephyr-prio
        periodic4QSto,         // storage for the AO's queue
        Q_DIM(periodic4QSto),  // queue length
        periodic4Stack,        // stack storage (needed for FreeRTOS)
        K_THREAD_STACK_SIZEOF(periodic4Stack), // stack size [Zephyr]
        getEvtPeriodic4(0U));  // initialization event
}
//............................................................................
void d1on()  { GPIOA->BSRR = (1U << TST1_PIN); __NOP(); __NOP(); }
void d1off() { GPIOA->BSRR = (1U << (TST1_PIN + 16U)); __NOP(); __NOP(); }
//............................................................................
void d2on()  { GPIOA->BSRR = (1U << TST2_PIN); __NOP(); __NOP(); }
void d2off() { GPIOA->BSRR = (1U << (TST2_PIN + 16U)); __NOP(); __NOP(); }
//............................................................................
void d3on()  { GPIOA->BSRR = (1U << TST3_PIN); __NOP(); __NOP(); }
void d3off() { GPIOA->BSRR = (1U << (TST3_PIN + 16U)); __NOP(); __NOP(); }
//............................................................................
void d4on()  { GPIOA->BSRR = (1U << TST4_PIN); __NOP(); __NOP(); }
void d4off() { GPIOA->BSRR = (1U << (TST4_PIN + 16U)); __NOP(); __NOP(); }
//............................................................................
void d5on()  { GPIOA->BSRR = (1U << TST5_PIN); __NOP(); __NOP(); }
void d5off() { GPIOA->BSRR = (1U << (TST5_PIN + 16U)); __NOP(); __NOP(); }
//............................................................................
void d6on()  { GPIOA->BSRR = (1U << TST6_PIN); __NOP(); __NOP(); }
void d6off() { GPIOA->BSRR = (1U << (TST6_PIN + 16U)); __NOP(); __NOP(); }
//............................................................................
void d7on()  { GPIOA->BSRR = (1U << TST7_PIN); __NOP(); __NOP(); }
void d7off() { GPIOA->BSRR = (1U << (TST7_PIN + 16U)); __NOP(); __NOP(); }

//............................................................................
QP::QEvt const *getEvtPeriodic1(uint8_t num) {
    // immutable PERIODIC_SPEC events for Periodic1
    static APP::PeriodicSpecEvt const periodicSpec1[] {
        APP::PeriodicSpecEvt(APP::PERIODIC_SPEC_SIG, 40U, 5U),
        APP::PeriodicSpecEvt(APP::PERIODIC_SPEC_SIG, 30U, 7U)
    };
    Q_REQUIRE_ID(500, num < Q_DIM(periodicSpec1)); // must be in range
    return &periodicSpec1[num];
}
//............................................................................
QP::QEvt const *getEvtPeriodic4(uint8_t num) {
    // immutable PERIODIC_SPEC events for Periodic4
    static APP::PeriodicSpecEvt const periodicSpec4[] {
        APP::PeriodicSpecEvt(APP::PERIODIC_SPEC_SIG, 20U, 2U),
        APP::PeriodicSpecEvt(APP::PERIODIC_SPEC_SIG, 10U, 1U)
    };
    Q_REQUIRE_ID(600, num < Q_DIM(periodicSpec4)); // must be in range
    return &periodicSpec4[num];
}

} // namespace BSP

// QF callbacks ==============================================================
namespace QP {

//............................................................................
void QF::onStartup() {
    k_timer_init(&zephyr_tick_timer, &custom_tick_callback, NULL);
    k_timer_start(&zephyr_tick_timer, K_TICKS(1), K_TICKS(1));
}
//............................................................................
void QF::onCleanup() {
}
//............................................................................
#ifdef QF_IDLE
void QF::onIdle(void) {
    BSP::d7on();
    BSP::d7off();
}
#endif

} // namespace QP
```

## src/bsp.hpp
```c
//============================================================================
// "real-time" example to demonstrate timing in QP/C++
//
// Copyright (C) 2005-2026 Quantum Leaps, LLC. All rights reserved.
//
//                    Q u a n t u m  L e a P s
//                    ------------------------
//                    Modern Embedded Software
//
// SPDX-License-Identifier: GPL-3.0-or-later OR LicenseRef-QL-commercial
//
// This software is dual-licensed under the terms of the open-source GNU
// General Public License, version 3 or later (GPL-3.0-or-later), or,
// alternatively, under the terms of one of the closed-source Quantum Leaps
// commercial licenses.
//
// Redistributions in source code must retain this top-level comment block.
//
// NOTE:
// The GPL does NOT permit distributing this code as part of proprietary
// (closed-source) programs. For such use, please contact Quantum Leaps for
// a commercial license, which is an alternative to the GPL designed
// explicitly for closed-source distribution.
//
// Quantum Leaps contact information:
// <www.state-machine.com/licensing>
// <info@state-machine.com>
//============================================================================
#ifndef BSP_HPP_
#define BSP_HPP_

namespace BSP {

constexpr std::uint32_t TICKS_PER_SEC {CONFIG_SYS_CLOCK_TICKS_PER_SEC};

void init(void const * const arg);

void d1on();
void d1off();

void d2on();
void d2off();

void d3on();
void d3off();

void d4on();
void d4off();

void d5on();
void d5off();

void d6on();
void d6off();

void d7on();
void d7off();

// immutable events for Periodic active objects
QP::QEvt const *getEvtPeriodic1(std::uint8_t num);
QP::QEvt const *getEvtPeriodic4(std::uint8_t num);

} // namespace BSP

#endif // BSP_HPP_
```

## src/periodic1.cpp
```c
//$file${.::periodic1.cpp} vvvvvvvvvvvvvvvvvvvvvvvvvvvvvvvvvvvvvvvvvvvvvvvvvvv
//
// Model: real-time.qm
// File:  ${.::periodic1.cpp}
//
// This code has been generated by QM 7.0.4 <www.state-machine.com/qm>.
// DO NOT EDIT THIS FILE MANUALLY. All your changes will be lost.
//
// Copyright (c) 2005 Quantum Leaps, LLC. All rights reserved.
//
//                 ____________________________________
//                /                                   /
//               /    GGGGGGG    PPPPPPPP   LL       /
//              /   GG     GG   PP     PP  LL       /
//             /   GG          PP     PP  LL       /
//            /   GG   GGGGG  PPPPPPPP   LL       /
//           /   GG      GG  PP         LL       /
//          /     GGGGGGG   PP         LLLLLLL  /
//         /___________________________________/
//
// SPDX-License-Identifier: GPL-3.0-or-later
//
// This generated code is open-source software licensed under the GNU
// General Public License (GPL) as published by the Free Software Foundation
// (see <https://www.gnu.org/licenses>).
//
// NOTE:
// The GPL does NOT permit the incorporation of this code into proprietary
// programs. Please contact Quantum Leaps for commercial licensing options,
// which expressly supersede the GPL and are designed explicitly for
// closed-source distribution.
//
// Quantum Leaps contact information:
// <www.state-machine.com/licensing>
// <info@state-machine.com>
//
//$endhead${.::periodic1.cpp} ^^^^^^^^^^^^^^^^^^^^^^^^^^^^^^^^^^^^^^^^^^^^^^^^
#include "qpcpp.hpp"           // QP/C++ real-time event framework
#include "bsp.hpp"             // Board Support Package
#include "app.hpp"             // Application interface

namespace {
Q_DEFINE_THIS_MODULE("periodic1")
}

//$declare${AOs::Periodic1} vvvvvvvvvvvvvvvvvvvvvvvvvvvvvvvvvvvvvvvvvvvvvvvvvv
namespace APP {

//${AOs::Periodic1} ..........................................................
class Periodic1 : public QP::QMActive {
private:
    QP::QTimeEvt m_te;
    std::uint16_t m_toggles;

public:
    static Periodic1 inst;

public:
    Periodic1();

protected:
    QM_STATE_DECL( initial);
    QM_STATE_DECL( active);
}; // class Periodic1

} // namespace APP
//$enddecl${AOs::Periodic1} ^^^^^^^^^^^^^^^^^^^^^^^^^^^^^^^^^^^^^^^^^^^^^^^^^^

//$skip${QP_VERSION} vvvvvvvvvvvvvvvvvvvvvvvvvvvvvvvvvvvvvvvvvvvvvvvvvvvvvvvvv
// Check for the minimum required QP version
#if (QP_VERSION < 800U) || (QP_VERSION != ((QP_RELEASE^4294967295U)%0x2710U))
#error qpcpp version 8.0.0 or higher required
#endif
//$endskip${QP_VERSION} ^^^^^^^^^^^^^^^^^^^^^^^^^^^^^^^^^^^^^^^^^^^^^^^^^^^^^^
//$define${Shared::AO_Periodic1} vvvvvvvvvvvvvvvvvvvvvvvvvvvvvvvvvvvvvvvvvvvvv
namespace APP {

//${Shared::AO_Periodic1} ....................................................
QP::QActive * const AO_Periodic1 {&Periodic1::inst};

} // namespace APP
//$enddef${Shared::AO_Periodic1} ^^^^^^^^^^^^^^^^^^^^^^^^^^^^^^^^^^^^^^^^^^^^^
//$define${AOs::Periodic1} vvvvvvvvvvvvvvvvvvvvvvvvvvvvvvvvvvvvvvvvvvvvvvvvvvv
namespace APP {

//${AOs::Periodic1} ..........................................................
Periodic1 Periodic1::inst;

//${AOs::Periodic1::Periodic1} ...............................................
Periodic1::Periodic1()
  : QMActive(Q_STATE_CAST(&Periodic1::initial)),
    m_te(this, TIMEOUT_SIG, 0U)
{}

//${AOs::Periodic1::SM} ......................................................
QM_STATE_DEF(Periodic1, initial) {
    //${AOs::Periodic1::SM::initial}
    Q_REQUIRE_ID(300, e->sig == PERIODIC_SPEC_SIG);

    m_te.armX(Q_EVT_CAST(PeriodicSpecEvt)->ticks,
              Q_EVT_CAST(PeriodicSpecEvt)->ticks);
    m_toggles = Q_EVT_CAST(PeriodicSpecEvt)->toggles;

    QS_FUN_DICTIONARY(&Periodic1::active);
    static constexpr QP::QMTranActTable tatbl_ = { // tran-action table
        &active_s, // target state
        {
            Q_ACTION_NULL // zero terminator
        }
    };
    return qm_tran_init(&tatbl_);
}

//${AOs::Periodic1::SM::active} ..............................................
QP::QMState const Periodic1::active_s = {
    QM_STATE_NULL, // superstate (top)
    &Periodic1::active,
    Q_ACTION_NULL, // no entry action
    Q_ACTION_NULL, // no exit action
    Q_ACTION_NULL  // no initial tran.
};
//${AOs::Periodic1::SM::active}
QM_STATE_DEF(Periodic1, active) {
    QP::QState status_;
    switch (e->sig) {
        //${AOs::Periodic1::SM::active::TIMEOUT}
        case TIMEOUT_SIG: {
            for (std::uint16_t i = m_toggles; i > 0U; --i) {
                BSP::d6on();
                BSP::d6off();
            }
            status_ = Q_RET_HANDLED;
            break;
        }
        //${AOs::Periodic1::SM::active::PERIODIC_SPEC}
        case PERIODIC_SPEC_SIG: {
            BSP::d6on();
            m_te.disarm();
            m_te.armX(Q_EVT_CAST(PeriodicSpecEvt)->ticks,
                      Q_EVT_CAST(PeriodicSpecEvt)->ticks);
            m_toggles = Q_EVT_CAST(PeriodicSpecEvt)->toggles;
            BSP::d6off();
            status_ = Q_RET_HANDLED;
            break;
        }
        default: {
            status_ = Q_RET_SUPER;
            break;
        }
    }
    return status_;
}

} // namespace APP
//$enddef${AOs::Periodic1} ^^^^^^^^^^^^^^^^^^^^^^^^^^^^^^^^^^^^^^^^^^^^^^^^^^^
```

## src/qp_config.hpp
```c
//============================================================================
// QP configuration file (Zephyr)
//
// Copyright (C) 2005 Quantum Leaps, LLC. All rights reserved.
//
//                    Q u a n t u m  L e a P s
//                    ------------------------
//                    Modern Embedded Software
//
// SPDX-License-Identifier: GPL-3.0-or-later OR LicenseRef-QL-commercial
//
// This software is dual-licensed under the terms of the open-source GNU
// General Public License (GPL) or under the terms of one of the closed-
// source Quantum Leaps commercial licenses.
//
// Redistributions in source code must retain this top-level comment block.
// Plagiarizing this software to sidestep the license obligations is illegal.
//
// NOTE:
// The GPL does NOT permit the incorporation of this code into proprietary
// programs. Please contact Quantum Leaps for commercial licensing options,
// which expressly supersede the GPL and are designed explicitly for
// closed-source distribution.
//
// Quantum Leaps contact information:
// <www.state-machine.com/licensing>
// <info@state-machine.com>
//============================================================================
#ifndef QP_CONFIG_HPP_
#define QP_CONFIG_HPP_

//-------- <<< Use Configuration Wizard in Context Menu >>> -----------------

// <o>QP API compatibility version (QP_API_VERSION)
//   <0=>  0   (Maximum compatibility)
//   <691=>691 (QP 6.9.1 or newer)
//   <750=>750 (QP 7.5.0 or newer)
//   <9999=>9999 (Latest only)
// <i>QP API backwards compatibility with the QP API version.
// <i>Lower QP_API_VERSION values enable backwards compatibility
// <i>with lower (older) QP API versions.
// <i>For example, QP_API_VERSION==691 will enable the compatibility
// <i>layer with QP version 6.9.1 and newer, but not older than 6.9.1.
// <i>QP_API_VERSION==0 enables the maximum currently supported
// <i>backwards compatibility. Conversely, QP_API_VERSION==9999 means
// <i>that no backwards compatibility layer should be enabled.
// <i>Default: 0 (All supported)
#define QP_API_VERSION 0

//..........................................................................
// <h>QF Framework (Active Objects)
// <i>Active Object framework

// <o>Maximum # Active Objects (QF_MAX_ACTIVE) <1-64>
// <i>Maximum # Active Objects in the system <1..64>
// <i>Default: 32
#define QF_MAX_ACTIVE  CONFIG_NUM_PREEMPT_PRIORITIES

// <o>Maximum # event pools (QF_MAX_EPOOL)
// <0=>0 no event pools
// <1=>1 <2=>2 <3=>3 (default) <4=>4 <5=>5
// <6=>6 <7=>7 <8=>8 <9=>9 <10=>10 <11=>11
// <12=>12 <13=>13 <14=>14 <15=>15
// <i>Maximum # Event Pools <1..15>
// <i>Default: 3
#define QF_MAX_EPOOL 3U

// <o>Maximum # clock tick rates (QF_MAX_TICK_RATE)
// <0=>0 no time events
// <1=>1 (default) <2=>2 <3=>3 <4=>4 <5=>5
// <6=>6 <7=>7 <8=>8 <9=>9 <10=>10 <11=>11
// <12=>12 <13=>13 <14=>14 <15=>15
// <i>Maximum # clock tick rates for time events <1..15>
// <i>Default: 1
#define QF_MAX_TICK_RATE 1U

// <o>Event size (QF_EVENT_SIZ_SIZE)
//   <1U=>1
//   <2U=>2 (default)
//   <4U=>4
// <i>Size of the dynamic events for QF [bytes]
// <i>Default: 2 (64K bytes maximum event size)
#define QF_EVENT_SIZ_SIZE   2U

// <o>Time event counter size (QF_TIMEEVT_CTR_SIZE)
//   <1U=>1
//   <2U=>2
//   <4U=>4 (default)
// <i>Size of the QTimeEvt counter [bytes]
// <i>Default: 4 (2^32 dynamic range)
#define QF_TIMEEVT_CTR_SIZE 4U

// <o>Event queue counter size (QF_EQUEUE_CTR_SIZE)
//   <1U=>1 (default)
//   <2U=>2
// <i>Size of event queue counter [bytes]
// <i>Default: 1 (255 events maximum in a queue)
#define QF_EQUEUE_CTR_SIZE  1U

// <o>Memory pool counter size (QF_MPOOL_CTR_SIZE)
//   <1U=>1
//   <2U=>2 (default)
//   <4U=>4
// <i>Size of memory pool counter [bytes]
// <i>Default: 2 (64K blocks maximum in a pool)
#define QF_MPOOL_CTR_SIZE 2U

// <o>Memory block size (QF_MPOOL_SIZ_SIZE)
//   <1U=>1
//   <2U=>2 (default)
//   <4U=>4
// <i>Size of memory pool block [bytes]
// <i>Default: 2 (64K bytes maximum block size)
#define QF_MPOOL_SIZ_SIZE 2U

// <c2>Enable event parameter initialization (QEVT_PAR_INIT)
// <i>Initialize parameters of dynamic events at allocation
// <i>(Resource Acquisition Is Initialization (RAII) for dynamic events)
//#define QEVT_PAR_INIT
// </c>

// <c1>Provide destructors for QP classes
// <i>Presence of destructors pulls in the C++ delete() opeator
// <i>NOTE: Not recommended
//#define Q_XTOR
// </c>

// <c1>Enable active object stop API (QACTIVE_CAN_STOP)
// <i>NOTE: Not recommended
//#define QACTIVE_CAN_STOP
// </c>

// <c1>Enable context switch callback *without* QS (QF_ON_CONTEXT_SW)
// <i>Context switch callback QF_onContextSw() when Q_SPY is undefined.
//#ifndef Q_SPY
//#define QF_ON_CONTEXT_SW
//#endif
// </c>

// <c1>Enable context switch callback *with* QS (QF_ON_CONTEXT_SW)
// <i>Context switch callback QF_onContextSw() when Q_SPY is defined.
//#ifdef Q_SPY
//#define QF_ON_CONTEXT_SW
//#endif
// </c>

// <c2>Enable memory isolation (QF_MEM_ISOLATE)
// <i>Memory isolation (supported in SafeQP only, requires MPU)
// <i>NOTE: implies QF_ON_CONTEXT_SW.
//#define QF_MEM_ISOLATE
// </c>

// </h>

//..........................................................................
// <h>QS Software Tracing (Q_SPY)
// <i>Target-resident component of QP/Spy software tracing system
// <i>(tracing instrumentation and command-input).
// <i>NOTE: The QS software tracing instrumentation is activated only when
// <i>the macro Q_SPY is defined on the command-line to the compiler.
// <i>Typically, Q_SPY is defined only in the "spy" build configuration.

// <o>QS timestamp size (QS_TIME_SIZE)
//   <1U=>1
//   <2U=>2
//   <4U=>4 (default)
// <i>Size of the timestamp in QS [bytes]
// <i>Default: 4 (2^32 dynamic range)
#define QS_TIME_SIZE 4U

// <o>QS buffer counter size (QS_CTR_SIZE)
//   <1U=>1
//   <2U=>2 (default)
//   <4U=>4
// <i>Size of the counter in the internal QS buffer [bytes]
// <i>Default: 2 (64K bytes in QS buffer)
#define QS_CTR_SIZE 2U

// </h>

//------------- <<< end of configuration section >>> -----------------------

#endif // QP_CONFIG_HPP_
```

## src/sporadic2.cpp
```c
//$file${.::sporadic2.cpp} vvvvvvvvvvvvvvvvvvvvvvvvvvvvvvvvvvvvvvvvvvvvvvvvvvv
//
// Model: real-time.qm
// File:  ${.::sporadic2.cpp}
//
// This code has been generated by QM 7.0.1 <www.state-machine.com/qm>.
// DO NOT EDIT THIS FILE MANUALLY. All your changes will be lost.
//
// Copyright (c) 2005 Quantum Leaps, LLC. All rights reserved.
//
//                 ____________________________________
//                /                                   /
//               /    GGGGGGG    PPPPPPPP   LL       /
//              /   GG     GG   PP     PP  LL       /
//             /   GG          PP     PP  LL       /
//            /   GG   GGGGG  PPPPPPPP   LL       /
//           /   GG      GG  PP         LL       /
//          /     GGGGGGG   PP         LLLLLLL  /
//         /___________________________________/
//
// SPDX-License-Identifier: GPL-3.0-or-later
//
// This generated code is open-source software licensed under the GNU
// General Public License (GPL) as published by the Free Software Foundation
// (see <https://www.gnu.org/licenses>).
//
// NOTE:
// The GPL does NOT permit the incorporation of this code into proprietary
// programs. Please contact Quantum Leaps for commercial licensing options,
// which expressly supersede the GPL and are designed explicitly for
// closed-source distribution.
//
// Quantum Leaps contact information:
// <www.state-machine.com/licensing>
// <info@state-machine.com>
//
//$endhead${.::sporadic2.cpp} ^^^^^^^^^^^^^^^^^^^^^^^^^^^^^^^^^^^^^^^^^^^^^^^^
#include "qpcpp.hpp"           // QP/C++ real-time event framework
#include "bsp.hpp"             // Board Support Package
#include "app.hpp"             // Application interface

namespace {
//Q_DEFINE_THIS_MODULE("sporadic2")
}

//$declare${AOs::Sporadic2} vvvvvvvvvvvvvvvvvvvvvvvvvvvvvvvvvvvvvvvvvvvvvvvvvv
namespace APP {

//${AOs::Sporadic2} ..........................................................
class Sporadic2 : public QP::QMActive {
public:
    static Sporadic2 inst;

public:
    Sporadic2();

protected:
    QM_STATE_DECL( initial);
    QM_STATE_DECL( active);
}; // class Sporadic2

} // namespace APP
//$enddecl${AOs::Sporadic2} ^^^^^^^^^^^^^^^^^^^^^^^^^^^^^^^^^^^^^^^^^^^^^^^^^^

//$skip${QP_VERSION} vvvvvvvvvvvvvvvvvvvvvvvvvvvvvvvvvvvvvvvvvvvvvvvvvvvvvvvvv
// Check for the minimum required QP version
#if (QP_VERSION < 730U) || (QP_VERSION != ((QP_RELEASE^4294967295U)%0x2710U))
#error qpcpp version 7.3.0 or higher required
#endif
//$endskip${QP_VERSION} ^^^^^^^^^^^^^^^^^^^^^^^^^^^^^^^^^^^^^^^^^^^^^^^^^^^^^^
//$define${Shared::AO_Sporadic2} vvvvvvvvvvvvvvvvvvvvvvvvvvvvvvvvvvvvvvvvvvvvv
namespace APP {

//${Shared::AO_Sporadic2} ....................................................
QP::QActive * const AO_Sporadic2 {&Sporadic2::inst};

} // namespace APP
//$enddef${Shared::AO_Sporadic2} ^^^^^^^^^^^^^^^^^^^^^^^^^^^^^^^^^^^^^^^^^^^^^
//$define${AOs::Sporadic2} vvvvvvvvvvvvvvvvvvvvvvvvvvvvvvvvvvvvvvvvvvvvvvvvvvv
namespace APP {

//${AOs::Sporadic2} ..........................................................
Sporadic2 Sporadic2::inst;

//${AOs::Sporadic2::Sporadic2} ...............................................
Sporadic2::Sporadic2()
  : QMActive(Q_STATE_CAST(&Sporadic2::initial))
{}

//${AOs::Sporadic2::SM} ......................................................
QM_STATE_DEF(Sporadic2, initial) {
    //${AOs::Sporadic2::SM::initial}
    Q_UNUSED_PAR(e);

    QS_FUN_DICTIONARY(&Sporadic2::active);
    static QP::QMTranActTable const tatbl_ = { // tran-action table
        &active_s, // target state
        {
            Q_ACTION_NULL // zero terminator
        }
    };
    return qm_tran_init(&tatbl_);
}

//${AOs::Sporadic2::SM::active} ..............................................
QP::QMState const Sporadic2::active_s = {
    QM_STATE_NULL, // superstate (top)
    &Sporadic2::active,
    Q_ACTION_NULL, // no entry action
    Q_ACTION_NULL, // no exit action
    Q_ACTION_NULL  // no initial tran.
};
//${AOs::Sporadic2::SM::active}
QM_STATE_DEF(Sporadic2, active) {
    QP::QState status_;
    switch (e->sig) {
        //${AOs::Sporadic2::SM::active::SPORADIC_A}
        case SPORADIC_A_SIG: {
            BSP::d5on();
            AO_Sporadic3->POST(e, this); // Sporadic2 --> Sporadic3
            BSP::d5off();
            status_ = Q_RET_HANDLED;
            break;
        }
        //${AOs::Sporadic2::SM::active::SPORADIC_B}
        case SPORADIC_B_SIG: {
            BSP::d5on();
            AO_Periodic1->POST(BSP::getEvtPeriodic1(1U), this);
            BSP::d5off();

            for (std::uint16_t i = Q_EVT_CAST(SporadicSpecEvt)->toggles;
                 i > 0U; --i)
            {
                BSP::d5on();
                BSP::d5off();
            }
            status_ = Q_RET_HANDLED;
            break;
        }
        default: {
            status_ = Q_RET_SUPER;
            break;
        }
    }
    return status_;
}

} // namespace APP
//$enddef${AOs::Sporadic2} ^^^^^^^^^^^^^^^^^^^^^^^^^^^^^^^^^^^^^^^^^^^^^^^^^^^
```

## src/sporadic3.cpp
```c
//$file${.::sporadic3.cpp} vvvvvvvvvvvvvvvvvvvvvvvvvvvvvvvvvvvvvvvvvvvvvvvvvvv
//
// Model: real-time.qm
// File:  ${.::sporadic3.cpp}
//
// This code has been generated by QM 7.0.1 <www.state-machine.com/qm>.
// DO NOT EDIT THIS FILE MANUALLY. All your changes will be lost.
//
// Copyright (c) 2005 Quantum Leaps, LLC. All rights reserved.
//
//                 ____________________________________
//                /                                   /
//               /    GGGGGGG    PPPPPPPP   LL       /
//              /   GG     GG   PP     PP  LL       /
//             /   GG          PP     PP  LL       /
//            /   GG   GGGGG  PPPPPPPP   LL       /
//           /   GG      GG  PP         LL       /
//          /     GGGGGGG   PP         LLLLLLL  /
//         /___________________________________/
//
// SPDX-License-Identifier: GPL-3.0-or-later
//
// This generated code is open-source software licensed under the GNU
// General Public License (GPL) as published by the Free Software Foundation
// (see <https://www.gnu.org/licenses>).
//
// NOTE:
// The GPL does NOT permit the incorporation of this code into proprietary
// programs. Please contact Quantum Leaps for commercial licensing options,
// which expressly supersede the GPL and are designed explicitly for
// closed-source distribution.
//
// Quantum Leaps contact information:
// <www.state-machine.com/licensing>
// <info@state-machine.com>
//
//$endhead${.::sporadic3.cpp} ^^^^^^^^^^^^^^^^^^^^^^^^^^^^^^^^^^^^^^^^^^^^^^^^
#include "qpcpp.hpp"           // QP/C++ real-time event framework
#include "bsp.hpp"             // Board Support Package
#include "app.hpp"             // Application interface

namespace {
//Q_DEFINE_THIS_MODULE("sporadic3")
}

//$declare${AOs::Sporadic3} vvvvvvvvvvvvvvvvvvvvvvvvvvvvvvvvvvvvvvvvvvvvvvvvvv
namespace APP {

//${AOs::Sporadic3} ..........................................................
class Sporadic3 : public QP::QMActive {
public:
    static Sporadic3 inst;

public:
    Sporadic3();

protected:
    QM_STATE_DECL( initial);
    QM_STATE_DECL( active);
}; // class Sporadic3

} // namespace APP
//$enddecl${AOs::Sporadic3} ^^^^^^^^^^^^^^^^^^^^^^^^^^^^^^^^^^^^^^^^^^^^^^^^^^

//$skip${QP_VERSION} vvvvvvvvvvvvvvvvvvvvvvvvvvvvvvvvvvvvvvvvvvvvvvvvvvvvvvvvv
// Check for the minimum required QP version
#if (QP_VERSION < 730U) || (QP_VERSION != ((QP_RELEASE^4294967295U)%0x2710U))
#error qpcpp version 7.3.0 or higher required
#endif
//$endskip${QP_VERSION} ^^^^^^^^^^^^^^^^^^^^^^^^^^^^^^^^^^^^^^^^^^^^^^^^^^^^^^
//$define${Shared::AO_Sporadic3} vvvvvvvvvvvvvvvvvvvvvvvvvvvvvvvvvvvvvvvvvvvvv
namespace APP {

//${Shared::AO_Sporadic3} ....................................................
QP::QActive * const AO_Sporadic3 {&Sporadic3::inst};

} // namespace APP
//$enddef${Shared::AO_Sporadic3} ^^^^^^^^^^^^^^^^^^^^^^^^^^^^^^^^^^^^^^^^^^^^^
//$define${AOs::Sporadic3} vvvvvvvvvvvvvvvvvvvvvvvvvvvvvvvvvvvvvvvvvvvvvvvvvvv
namespace APP {

//${AOs::Sporadic3} ..........................................................
Sporadic3 Sporadic3::inst;

//${AOs::Sporadic3::Sporadic3} ...............................................
Sporadic3::Sporadic3()
  : QMActive(Q_STATE_CAST(&Sporadic3::initial))
{}

//${AOs::Sporadic3::SM} ......................................................
QM_STATE_DEF(Sporadic3, initial) {
    //${AOs::Sporadic3::SM::initial}
    Q_UNUSED_PAR(e);

    QS_FUN_DICTIONARY(&Sporadic3::active);
    static QP::QMTranActTable const tatbl_ = { // tran-action table
        &active_s, // target state
        {
            Q_ACTION_NULL // zero terminator
        }
    };
    return qm_tran_init(&tatbl_);
}

//${AOs::Sporadic3::SM::active} ..............................................
QP::QMState const Sporadic3::active_s = {
    QM_STATE_NULL, // superstate (top)
    &Sporadic3::active,
    Q_ACTION_NULL, // no entry action
    Q_ACTION_NULL, // no exit action
    Q_ACTION_NULL  // no initial tran.
};
//${AOs::Sporadic3::SM::active}
QM_STATE_DEF(Sporadic3, active) {
    QP::QState status_;
    switch (e->sig) {
        //${AOs::Sporadic3::SM::active::SPORADIC_A}
        case SPORADIC_A_SIG: {
            BSP::d4on();
            // Sporadic3 --> Periodic4
            AO_Periodic4->POST(BSP::getEvtPeriodic4(1U), this);
            BSP::d4off();

            for (std::uint16_t i = Q_EVT_CAST(SporadicSpecEvt)->toggles;
                 i > 0U; --i)
            {
                BSP::d4on();
                BSP::d4off();
            }
            status_ = Q_RET_HANDLED;
            break;
        }
        default: {
            status_ = Q_RET_SUPER;
            break;
        }
    }
    return status_;
}

} // namespace APP
//$enddef${AOs::Sporadic3} ^^^^^^^^^^^^^^^^^^^^^^^^^^^^^^^^^^^^^^^^^^^^^^^^^^^
```
